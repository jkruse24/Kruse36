## boards/shields/kruse36/Kconfig.defconfig
```kconfig
if SHIELD_KRUSE36_LEFT

config ZMK_KEYBOARD_NAME
    default "Kruse36"

config ZMK_SPLIT_ROLE_CENTRAL
    default y

endif

if SHIELD_KRUSE36_LEFT || SHIELD_KRUSE36_RIGHT

config ZMK_SPLIT
    default y

endif
```

## boards/shields/kruse36/Kconfig.shield
```kconfig
config SHIELD_KRUSE36_LEFT
    def_bool $(shields_list_contains,kruse36_left)

config SHIELD_KRUSE36_RIGHT
    def_bool $(shields_list_contains,kruse36_right)
```
