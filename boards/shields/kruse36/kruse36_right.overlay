#include "kruse36.dtsi"

&default_transform {
    col-offset = <5>;
};

&kscan0 {
    row-gpios = <
        &gpio0 31 (GPIO_ACTIVE_HIGH | GPIO_PULL_DOWN) /* Row 0 - Top (swapped) */
        &gpio0 29 (GPIO_ACTIVE_HIGH | GPIO_PULL_DOWN) /* Row 1 - Home (swapped) */
        &gpio1 0  (GPIO_ACTIVE_HIGH | GPIO_PULL_DOWN) /* Row 2 - Bottom */
        &gpio0 2  (GPIO_ACTIVE_HIGH | GPIO_PULL_DOWN) /* Row 3 - Thumb */
    >;

    col-gpios = <
        &gpio0 6  GPIO_ACTIVE_HIGH /* Col 0 - Pinky */
        &gpio0 8  GPIO_ACTIVE_HIGH /* Col 1 - Ring */
        &gpio0 17 GPIO_ACTIVE_HIGH /* Col 2 - Middle */
        &gpio0 20 GPIO_ACTIVE_HIGH /* Col 3 - Index */
        &gpio0 22 GPIO_ACTIVE_HIGH /* Col 4 - Inner */
    >;
};
